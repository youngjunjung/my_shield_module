## boards/shields/zmk-keyboard-peto/Kconfig.defconfig
```kconfig
if SHIELD_PEC_LEFT

# Name must be less than 16 characters long!
config ZMK_KEYBOARD_NAME
    default "peto"

config ZMK_SPLIT_ROLE_CENTRAL
    default y

endif

if SHIELD_PEC_LEFT || SHIELD_PEC_RIGHT

config ZMK_SPLIT
    default y

endif
```

## boards/shields/zmk-keyboard-peto/Kconfig.shield
```kconfig
# No whitespace after the comma or in your part name!
config SHIELD_PEC_LEFT
    def_bool $(shields_list_contains,pec_left)

# No whitespace after the comma or in your part name!
config SHIELD_PEC_RIGHT
    def_bool $(shields_list_contains,pec_right)
```
